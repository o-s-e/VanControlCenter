// File generated 13-Jan-18 15:24:48
// Warning! This is a generated file, any manual changes will be
// lost during the next generation.

#constant  Strings0Count    0
#constant  Strings0Size     1
// object indexes into ImageControl
#CONST
    i4Dbutton0      // offset 0x0
    iStatictext0    // offset 0x4200
    iStatictext1    // offset 0x4E00
    i4Dbutton1      // offset 0x5C00
    i4Dbutton2      // offset 0x9E00
    i4Dbutton3      // offset 0xE000
    iKnob0          // offset 0x12200
    iSlider0        // offset 0x50BC00
    iSlider1        // offset 0x63B600
    iSlider2        // offset 0x76B000
    i4Dbutton4      // offset 0x89AA00
    iStatictext2    // offset 0x89F400
    i4Dbutton5      // offset 0x8A0400
    i4Dbutton6      // offset 0x8A4600
    i4Dbutton7      // offset 0x8A8800
    i4Dbutton8      // offset 0x8ACA00
    i4Dbutton9      // offset 0x8AF000
    iStatictext3    // offset 0x8B1600
    i4Dbutton10     // offset 0x8B2C00
    i4Dbutton11     // offset 0x8B6E00
    i4Dbutton12     // offset 0x8BB000
    iThermometer0   // offset 0x8BF200
    iSlider3        // offset 0xD2D800
#END

#constant  Strings0StartH   0x0
#constant  Strings0StartL   0x0
#IFNOT EXISTS NOGLOBALS
var hndl ;
#ENDIF
